## drivers/misc/mediatek/aw9523/Kconfig
```kconfig
config MTK_AW9523
	tristate "MTK AW9523 Support"
	default n
	help
	  Say Y here if you have AW9523 Key device.

	  If unsure, say Y.

config MTK_AW9524_UNDER_AW9523_LED
	tristate "MTK AW9524 under AW9523 LED Support"
	default n
	help
	  Say Y here if building for Astro Slide.
```
